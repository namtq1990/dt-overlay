## sprd.its
```
// SPDX-License-Identifier: (GPL-2.0+ OR MIT)
/*
 * sam9x60_curiosity.its - Flattened Image Tree file for SAM9X60 Curiosity board
 *
 * Copyright (C) 2021 Microchip Technology Inc. and its subsidiaries
 *
 * Author: Hari Prasath G.E <Hari.PrasathGE@microchip.com>
 */
/dts-v1/;

/ {
	description = "Nucare SPRD FIT Image";
	#address-cells = <1>;

	images {
		kernel {
			description = "Linux4SAM Linux kernel";
			data = /incbin/("./zImage");
			type = "kernel";
			arch = "arm";
			os = "linux";
			compression = "none";
			load = <0x22000000>;
			entry = <0x22000000>;
			hash-1 {
				algo = "crc32";
			};
			hash-2 {
				algo = "sha1";
			};
		};

		base_fdt {
			description = "SPRD Flattened Device Tree blob";
			data = /incbin/("./nc-sprd.dtb");
			type = "flat_dt";
			arch = "arm";
			compression = "none";
			load = <0x23000000>;
			hash-1 {
				algo = "crc32";
			};
			hash-2 {
				algo = "sha1";
			};
		};

		fdt_wilc3000 {
			description = "Device Tree blob WILC3000 overlay";
			data =
			/incbin/("./sprd/sprd_wilc3000.dtbo");
			type = "flat_dt";
			arch = "arm";
			compression = "none";
			load = <0x23010000>;
			hash-1 {
				algo = "crc32";
			};
			hash-2 {
				algo = "sha1";
			};
		};

		fdt_isi {
			description = "Device Tree blob ISI overlay";
			data =
			/incbin/("./sprd/sprd_isi.dtbo");
			type = "flat_dt";
			arch = "arm";
			compression = "none";
			load = <0x23020000>;
			hash-1 {
				algo = "crc32";
			};
			hash-2 {
				algo = "sha1";
			};
		};

		fdt_ov2640 {
			description = "Device Tree blob OV2640 overlay";
			data =
			/incbin/("./sprd/sprd_ov2640.dtbo");
			type = "flat_dt";
			arch = "arm";
			compression = "none";
			load = <0x23030000>;
			hash-1 {
				algo = "crc32";
			};
			hash-2 {
				algo = "sha1";
			};
		};

		fdt_ov5640 {
			description = "Device Tree blob OV5640 overlay";
			data =
			/incbin/("./sprd/sprd_ov5640.dtbo");
			type = "flat_dt";
			arch = "arm";
			compression = "none";
			load = <0x23030000>;
			hash-1 {
				algo = "crc32";
			};
			hash-2 {
				algo = "sha1";
			};
		};
		
		fdt_imu20948 {
			description = "Device Tree blob IMU20948 overlay";
			data =
			/incbin/("./sprd/sprd_imu20948.dtbo");
			type = "flat_dt";
			arch = "arm";
			compression = "none";
			load = <0x23040000>;
			hash-1 {
				algo = "crc32";
			};
			hash-2 {
				algo = "sha1";
			};
		};

		fdt_hh300 {
			description = "Device Tree blob HH300 overlay";
			data =
			/incbin/("./sprd/sprd_hh300.dtbo");
			type = "flat_dt";
			arch = "arm";
			compression = "none";
			load = <0x23100000>;
			hash-1 {
				algo = "crc32";
			};
			hash-2 {
				algo = "sha1";
			};
		};

		fdt_sprd {
			description = "Device Tree blob sprd overlay";
			data =
			/incbin/("./sprd/sprd_default.dtbo");
			type = "flat_dt";
			arch = "arm";
			compression = "none";
			load = <0x23300000>;
			hash-1 {
				algo = "crc32";
			};
			hash-2 {
				algo = "sha1";
			};
		};

    };

	configurations {
		default = "kernel_dtb";

		kernel_dtb {
			description = "Linux kernel and base FDT blob for SPRD board";
			kernel = "kernel";
			fdt = "base_fdt";
		};

		base_dtb {
			description = "Base FDT blob for SPRD board";
			fdt = "base_fdt";
		};

		wilc {
			description = "FDT overlay blob for WILC3000";
			fdt = "fdt_wilc3000";
		};

		isi {
			description = "FDT overlay blob for ISI";
			fdt = "fdt_isi";
		};

		ov2640 {
			description = "FDT overlay blob for OV2640";
			fdt = "fdt_ov2640";
		};

		ov5640 {
			description = "FDT overlay blob for OV5640";
			fdt = "fdt_ov5640";
		};

		imu {
			description = "FDT overlay blob for IMU";
			fdt = "fdt_imu20948";
		};

		hh300 {
			description = "FDT overlay blob for HH300";
			fdt = "fdt_hh300";
		};

		sprd {
			description = "FDT overlay blob for SPRD";
			fdt = "fdt_sprd";
		};
	};
};
```
